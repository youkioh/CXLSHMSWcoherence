## famfs-linux/kernel/swmc/Kconfig
```kconfig
# SPDX-License-Identifier: GPL-2.0

config PAGE_COHERENCE
	bool "Page coherence support for CXL shared memory"
	depends on X86_64
	help
	  Enable page coherence management for CXL shared memory environments.
	  This provides functionality for managing replica pages across
	  multiple CXL nodes to maintain memory coherence.

	  If unsure, say N.

config DE_STIJL
	bool "De Stijl implmentation for selective replcation and asynchronous transaction handling"
	depends on X86_64
	help
		Enable De Stijl for CXL shared memory environments.
		
		If unsure, say N.

config DE_STIJL_NO_ASYNC
	bool "De Stijl implementation without asynchronous transaction handling"
	depends on DE_STIJL
	help
		Enable De Stijl for CXL shared memory environments, but disable asynchronous transaction handling.	

		If unsure, say N.
```
